## drivers/fan/Kconfig
```kconfig
# Copyright (c) 2023 Google LLC
# SPDX-License-Identifier: Apache-2.0

menuconfig FAN
	bool "Fan control drivers"
	select PWM
	select SENSOR
	help
	  Enable Fan control drivers.

if FAN

module = FAN
module-str = fan
source "subsys/logging/Kconfig.template.log_config"

menu "Fan drivers"

config FAN_INIT_PRIORITY
	int "Fan subsystem and drivers init priority"
	default 91
	help
	  Fan subsystem and drivers initialization priority.

config FAN_SHELL
	bool "Fan shell"
	depends on SHELL
	default n
	help
	  This shell provides access to manipulating the fans.

source "drivers/fan/Kconfig.pid"

endmenu
endif
```

## drivers/fan/Kconfig.pid
```kconfig
# Copyright (c) 2023 Google LLC
# SPDX-License-Identifier: Apache-2.0

config FAN_PID
	bool "Fan control driver"
	default y
	select FPU
	depends on DT_HAS_ZEPHYR_FAN_PID_ENABLED
	help
	  Enable an abstract fan driver that uses the PID algorithm
	  in its control loop.
	  It adjusts the fan PWM to achieve and sustain desired RPM.
```

## dts/bindings/fan/fan-device.yaml
```yaml
# Copyright (c) 2023 Google LLC
# SPDX-License-Identifier: Apache-2.0

description: Fan Device

properties:
  pwm_min:
    type: int
    default: 0
    description: |
      The smallest allowed percentage of power that the fan can be set to when it's active.
      Has to within [0,100].
  pwm_max:
    type: int
    default: 100
    description: |
      The largest allowed percentage of power that the fan can be set to.
      Has to be within [0,100].
  "#fan-cells":
    type: int
    required: true
    description: Number of items to expect in a fan specifier
```

## dts/bindings/fan/zephyr,fan-pid.yaml
```yaml
# Copyright (c) 2023 Google LLC
# SPDX-License-Identifier: Apache-2.0

description: |
  Zephyr fan generic device node

  This defines a PID based fan control driver. From the control loop
  perspective a fan is composed of a PWM to adjust its power and a tachometer
  to report its current speed(RPM).

  For example:

  #include <dt-bindings/pwm/pwm.h>

  / {
      fan0: fan_0 {
          compatible = "zephyr,fan-pid";
          pwms = <&pwm0 0 PWM_KHZ(25) PWM_POLARITY_NORMAL>;
          tach = <&tach0>;
          pwm_min = <20>;
          pwn_max = <100>;
          kp = <13000>;
          ki = <30>;
          kd = <700000>;
          #fan-cells = <1>;
      };
  };

include: fan-device.yaml

compatible: "zephyr,fan-pid"

properties:
  pwms:
    required: true
    type: phandle-array
    description: Reference to a PWM specifier used to control the fan.
  tach:
    type: phandle
    description: Reference to a tachometer sensor device that raports the fan speed.
  kp:
    default: 0
    type: int
  ki:
    default: 0
    type: int
  kd:
    default: 0
    type: int
  "#fan-cells":
    type: int
    const: 1

fan-cells:
  - mode
```

## dts/bindings/test/vnd,sensor-device-2.yaml
```yaml
# Copyright (c) 2023 Google LLC
# SPDX-License-Identifier: Apache-2.0

description: VND sensor device

compatible: "vnd,sensor-device-2"

include: [sensor-device.yaml, base.yaml]

properties:
  reg:
    required: true

  "#sensor-cells":
    const: 2

sensor-cells:
  - channel
  - index
```
